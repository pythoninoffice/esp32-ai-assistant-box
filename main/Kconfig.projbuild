## main/Kconfig.projbuild
```kconfig
menu "ESP32 BT Mic"
    config MIC_GAIN_SHIFT
        int "Mic gain shift (lower = louder)"
        range 8 20
        default 14
    config SPK_DEFAULT_VOLUME
        int "Speaker start volume (0-127, PC can change it via AVRCP)"
        range 0 127
        default 80
config COD_PERIPHERAL
    bool "Advertise Class of Device as Peripheral/Keyboard (instead of Audio headset)"
    default n

    config ALTTAB_REPEAT_DELAY_MS
        int "Alt+Tab button: hold time before Tab starts repeating (ms)"
        range 100 3000
        default 600
    config ALTTAB_REPEAT_INTERVAL_MS
        int "Alt+Tab button: Tab repeat interval while held (ms)"
        range 100 3000
        default 500
    config ALTTAB_REPEAT_DELAY_MS
endmenu
```

## sdkconfig.defaults
```kconfig
CONFIG_BT_ENABLED=y
CONFIG_BTDM_CTRL_MODE_BR_EDR_ONLY=y
CONFIG_BTDM_CTRL_MODE_BLE_ONLY=n
CONFIG_BTDM_CTRL_MODE_BTDM=n
CONFIG_BTDM_CTRL_BR_EDR_SCO_DATA_PATH_HCI=y
CONFIG_BT_BLUEDROID_ENABLED=y
CONFIG_BT_CLASSIC_ENABLED=y
CONFIG_BT_BLE_ENABLED=n
CONFIG_BT_SSP_ENABLED=y
CONFIG_BT_HFP_ENABLE=y
CONFIG_BT_HFP_CLIENT_ENABLE=y
CONFIG_BT_HFP_AUDIO_DATA_PATH_HCI=y
CONFIG_BT_HFP_WBS_ENABLE=y
CONFIG_BT_A2DP_ENABLE=y
CONFIG_BT_AVRCP_ENABLED=y
CONFIG_PARTITION_TABLE_SINGLE_APP_LARGE=y
CONFIG_ESPTOOLPY_FLASHSIZE_4MB=y
CONFIG_BT_HID_ENABLED=y
CONFIG_BT_HID_DEVICE_ENABLED=y
```
